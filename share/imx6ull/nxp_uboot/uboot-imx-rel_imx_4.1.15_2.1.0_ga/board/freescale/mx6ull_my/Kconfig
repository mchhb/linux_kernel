## share/imx6ull/nxp_uboot/uboot-imx-rel_imx_4.1.15_2.1.0_ga/board/freescale/mx6ull_my/Kconfig
```kconfig
if TARGET_MX6ULL_MY

config SYS_BOARD
	default "mx6ull_my"

config SYS_VENDOR
	default "freescale"

config SYS_CONFIG_NAME
	default "mx6ull_my"

endif
```
